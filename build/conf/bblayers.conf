## build/conf/bblayers.conf
```bitbake
BBPATH := "${TOPDIR}"
BBFILES ?= ""

BBLAYERS = " \
  ${TOPDIR}/../meta-mw \
  ${TOPDIR}/../meta-drivers \
  ${TOPDIR}/../meta-system \
  ${TOPDIR}/../meta \
  ${TOPDIR}/../meta-common \
" 
```

## conf/bblayers.conf
```bitbake
BBLAYERS ?= " \
	/home/fal/opt/github/fafonline/bitbake/meta/recipes-ineo-x86-rt \
	/home/fal/opt/github/fafonline/bitbake/meta/recipes-image \
"
```

## meta-drivers/conf/layer.conf
```bitbake
BBPATH .= ":${LAYERDIR}"
BBFILES += "${LAYERDIR}/recipes-*/*/*.bb \
${LAYERDIR}/recipes-*/*/*.bbappend" 

BBFILE_COLLECTIONS += "drivers"
BBFILE_PATTERN_drivers = "^${LAYERDIR}/"
BBFILE_PRIORITY_drivers = "5"
LAYERVERSION_drivers = "1"
```

## meta-integ/conf/layer.conf
```bitbake
BBPATH .= ":${LAYERDIR}"
BBFILES += "${LAYERDIR}/recipes-*/*/*.bb" 
BBFILE_COLLECTIONS += "integ"
BBFILE_PATTERN_integ = "^${LAYERDIR}/"
BBFILE_PRIORITY_integ = "5"
LAYERVERSION_integ = "1"
```

## meta-mw/conf/layer.conf
```bitbake
BBPATH .= ":${LAYERDIR}"
BBFILES += "${LAYERDIR}/recipes-*/*/*.bb" 
BBFILE_COLLECTIONS += "mw"
BBFILE_PATTERN_mw = "^${LAYERDIR}/"
BBFILE_PRIORITY_mw = "5"
LAYERVERSION_mw = "1"
```

## meta-system/conf/layer.conf
```bitbake
BBPATH .= ":${LAYERDIR}"
BBFILES += "${LAYERDIR}/recipes-*/*/*.bb" 
BBFILE_COLLECTIONS += "mw"
BBFILE_PATTERN_system = "^${LAYERDIR}/"
BBFILE_PRIORITY_system = "5"
LAYERVERSION_system = "1"
```

## meta/recipes-image/conf/layer.conf
```bitbake
BBPATH  .= ":${LAYERDIR}"

BBFILES += "${LAYERDIR}/*.bb"
BBFILE_COLLECTIONS += "image"
BBFILE_PATTERN_image := "^${LAYERDIR}"
```

## meta/recipes-ineo-x86-rt/conf/layer.conf
```bitbake
BBPATH  .= ":${LAYERDIR}"

BBFILES += "${LAYERDIR}/*.bb"
BBFILE_COLLECTIONS += "ineo-x86-rt"
BBFILE_PATTERN_ineo-x86-rt := "^${LAYERDIR}"
```
